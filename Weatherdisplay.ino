/*
 * Weatherdisplay - generated by LCD Wizard (https://lcdwizard.com)
 *
 * Target : ESP32 (WROOM / WROVER)
 * Board  : ESP32-2432S028 "Cheap Yellow Display", two USB ports, ILI9341
 * Panel  : ILI9341  240x320  (SPI)
 * Touch  : XPT2046
 * Driver : TFT_eSPI
 * LVGL   : 8.3.x
 */

#include <Arduino.h>
#include <esp_log.h>
#include <lvgl.h>
#include "lcd_pins.h"
#include "src/ui/ui.h"
#include "src/ui/ui_fs.h"
#include "hardware.h"
#include "touch.h"
#include "wx_settings.h"
#include "wx_setup_ble.h"
#include <esp_bt.h>  // Frigor Bluetooth-minne vid normal drift.

// Your own code (File > Project settings > Your own code): write these three in
// a .cpp file of your own beside this sketch. lw_user.cpp has empty ones for when
// you have not, and the linker takes yours when you have.
void user_pre_ui_setup(void);
void user_setup(void);
void user_loop(void);

#include <TFT_eSPI.h>
TFT_eSPI tft = TFT_eSPI();

// ---- LVGL draw buffer ----
#define DRAW_BUF_LINES 10
static lv_disp_draw_buf_t draw_buf;
static lv_color_t *buf_1 = NULL;

// ---- backlight (PWM, 0-100 %) ----
static uint8_t backlight_level = LCD_BL_DEFAULT;
static bool backlight_pwm = true;   // false when no PWM channel could be had for the pin
uint8_t backlight_get(void) { return backlight_level; }

void backlight_set(uint8_t percent)
{
    if (percent > 100) percent = 100;
    backlight_level = percent;
    if (!backlight_pwm) {
        digitalWrite(LCD_BL_PIN, percent > 0 ? LCD_BL_ON_LEVEL : !LCD_BL_ON_LEVEL);
        return;
    }
    uint8_t duty = (uint8_t)(percent * 255 / 100);
    if (LCD_BL_ON_LEVEL == LOW) duty = 255 - duty;
    #if ESP_ARDUINO_VERSION_MAJOR >= 3
    ledcWrite(LCD_BL_PIN, duty);
    #else
    ledcWrite(0, duty);
    #endif
}

static void backlight_init(void)
{
    #if ESP_ARDUINO_VERSION_MAJOR >= 3
    if (!ledcAttach(LCD_BL_PIN, LCD_BL_FREQ, 8)) {
        Serial.println("backlight: no PWM channel could be had for GPIO 21, so it is switched on and off instead and cannot dim.");
        backlight_pwm = false;
        pinMode(LCD_BL_PIN, OUTPUT);
    }
    #else
    ledcSetup(0, LCD_BL_FREQ, 8);
    ledcAttachPin(LCD_BL_PIN, 0);
    #endif
    backlight_set(LCD_BL_DEFAULT);
}

// ---- display flush ----
static void disp_flush(lv_disp_drv_t *disp_drv, const lv_area_t *area, lv_color_t *color_p)
{
    uint32_t w = (area->x2 - area->x1 + 1);
    uint32_t h = (area->y2 - area->y1 + 1);
    tft.startWrite();
    tft.setAddrWindow(area->x1, area->y1, w, h);
    tft.pushColors((uint16_t *)color_p, w * h, LV_COLOR_16_SWAP == 0);
    tft.endWrite();
    lv_disp_flush_ready(disp_drv);
}

void setup()
{
    // Only this program speaks on the serial port: ESP-IDF's own messages are off.
    esp_log_level_set("*", ESP_LOG_NONE);
    Serial.begin(115200);
    #if ARDUINO_USB_CDC_ON_BOOT && ESP_ARDUINO_VERSION_MAJOR >= 3
    // Serial is the chip's own USB. With a PC attached and nothing reading
    // the port, every print would wait for it - and so would the UI. A
    // print waits a millisecond at most, and a line nobody is reading is
    // dropped after 20 of them.
    Serial.setTxTimeoutMs(1);
    #endif
    delay(100);
    Serial.println("Weatherdisplay starting...");

    // Konfiguration och normaldrift har olika startvagar. BLE+QR startas
    // INNAN LVGL, touch, SPIFFS och SMHI, vilket sparar kritiskt heap-minne.
    if (wx_boot_needs_setup()) {
        wx_run_ble_setup();  // Startar om efter lyckad konfiguration.
        // Kommer normalt aldrig tillbaka; inget LVGL far starta samtidigt.
        for (;;) delay(1000);
    }

    // BLE anvands bara i installationslaget ovan. Nar vi ar har har
    // wx_boot_needs_setup() returnerat false, och Bluetooth-kontrollern
    // ar inte initierad i denna uppstart. Aterta BT-minnet innan LVGL/HTTPS.
    // Release ar irreversibel under denna uppstart, men omkonfiguration
    // gor en ESP.restart(), sa Bluetooth blir ater tillgangligt da.
    const uint32_t wxBtHeapBefore = ESP.getFreeHeap();
    const esp_err_t wxBtRelease = esp_bt_mem_release(ESP_BT_MODE_BTDM);
    Serial.printf("WX: BT release status=%d, heap %u -> %u, maxblock=%u byte\n",
                  (int)wxBtRelease, wxBtHeapBefore, ESP.getFreeHeap(),
                  ESP.getMaxAllocHeap());

    // Your own code: hardware that must be set up before the screen starts. The
    // board is powered; the panel, touch and LVGL are not started yet, and the
    // screen stays dark while this runs: never wait for Wi-Fi here.
    user_pre_ui_setup();   // yours, or the empty one in lw_user.cpp

    // ---- panel ----
    tft.begin();
    tft.setRotation(LCD_ROTATION);
    tft.fillScreen(TFT_BLACK);
    backlight_init();

    touch_hw_init();

    // ---- LVGL ----
    lv_init();
    uint32_t draw_buf_lines = DRAW_BUF_LINES;
    buf_1 = (lv_color_t *)malloc(LCD_H_RES * draw_buf_lines * sizeof(lv_color_t));
    if (!buf_1) {
        free(buf_1);
        draw_buf_lines = DRAW_BUF_LINES >= 4 ? DRAW_BUF_LINES / 4 : 1;
        buf_1 = (lv_color_t *)malloc(LCD_H_RES * draw_buf_lines * sizeof(lv_color_t));
        Serial.printf("draw buffer: %u lines did not fit, so one buffer of %u lines is used and the screen redraws more slowly - lower Buffer height in Project settings.\n",
                      (unsigned)DRAW_BUF_LINES, (unsigned)draw_buf_lines);
        if (!buf_1) {
            Serial.println("draw buffer: not even that fits, so nothing can be drawn - lower Buffer height in Project settings.");
            while (1) delay(1000);
        }
    }
    lv_disp_draw_buf_init(&draw_buf, buf_1, NULL, LCD_H_RES * draw_buf_lines);

    static lv_disp_drv_t disp_drv;
    lv_disp_drv_init(&disp_drv);
    disp_drv.hor_res = SCREEN_WIDTH;
    disp_drv.ver_res = SCREEN_HEIGHT;
    disp_drv.flush_cb = disp_flush;
    disp_drv.draw_buf = &draw_buf;
    lv_disp_drv_register(&disp_drv);

    // ---- touch calibration (runs when needed; see touch_calibration_begin) ----
    touch_calibration_begin();

    touch_lvgl_init();

    // ---- peripherals and discrete I/O ----
    hw_init();

    // ---- asset filesystem (must be mounted before the UI is built) ----
    if (!ui_fs_init()) Serial.println("images will not load");

    ui_init();
    user_setup();   // yours, or the empty one in lw_user.cpp
    Serial.println("UI ready");
}

void loop()
{
    static uint32_t last = 0;
    uint32_t now = millis();
    lv_tick_inc(now - last);
    last = now;
    hw_poll(millis());
    user_loop();    // yours, or the empty one in lw_user.cpp
    lv_timer_handler();
    if (wx_restart_to_setup_requested()) {
        Serial.println("Konfiguration begard; startar om i BLE-lage");
        delay(150);
        ESP.restart();
    }
    delay(5);
}
